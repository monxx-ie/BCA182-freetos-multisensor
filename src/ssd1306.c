#include <string.h>
#include "ssd1306.h"
#include "stm32f1xx_hal.h"

#define SSD1306_ADDR    (0x3CU << 1)   /* 7-bit address 0x3C, HAL wants it shifted */
#define SSD1306_WIDTH   128U
#define SSD1306_PAGES   8U             /* 64 rows / 8 rows per page */
#define I2C_TIMEOUT_MS  100U

static I2C_HandleTypeDef hi2c1;
static uint8_t frame[SSD1306_WIDTH * SSD1306_PAGES];

/* Classic 5x7 ASCII font, characters 32..126, one byte per column (LSB = top) */
static const uint8_t font5x7[][5] = {
    {0x00,0x00,0x00,0x00,0x00}, {0x00,0x00,0x5F,0x00,0x00}, {0x00,0x07,0x00,0x07,0x00}, /* sp ! " */
    {0x14,0x7F,0x14,0x7F,0x14}, {0x24,0x2A,0x7F,0x2A,0x12}, {0x23,0x13,0x08,0x64,0x62}, /* # $ % */
    {0x36,0x49,0x55,0x22,0x50}, {0x00,0x05,0x03,0x00,0x00}, {0x00,0x1C,0x22,0x41,0x00}, /* & ' ( */
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    {0x00,0x41,0x36,0x08,0x00}, {0x10,0x08,0x08,0x10,0x08}                               /* } ~   */
};

static bool WriteCmd(uint8_t cmd)
{
    /* Control byte 0x00 = the following byte is a command */
    return HAL_I2C_Mem_Write(&hi2c1, SSD1306_ADDR, 0x00, I2C_MEMADD_SIZE_8BIT,
                             &cmd, 1, I2C_TIMEOUT_MS) == HAL_OK;
}

bool SSD1306_Init(void)
{
    hi2c1.Instance             = I2C1;
    hi2c1.Init.ClockSpeed      = 400000;
    hi2c1.Init.DutyCycle       = I2C_DUTYCYCLE_2;
    hi2c1.Init.OwnAddress1     = 0;
    hi2c1.Init.AddressingMode  = I2C_ADDRESSINGMODE_7BIT;
    hi2c1.Init.DualAddressMode = I2C_DUALADDRESS_DISABLE;
    hi2c1.Init.OwnAddress2     = 0;
    hi2c1.Init.GeneralCallMode = I2C_GENERALCALL_DISABLE;
    hi2c1.Init.NoStretchMode   = I2C_NOSTRETCH_DISABLE;
    if (HAL_I2C_Init(&hi2c1) != HAL_OK)   /* pins/clock: stm32f1xx_hal_msp.c */
    {
        return false;
    }

    static const uint8_t initSeq[] = {
        0xAE,        /* display off */
        0xD5, 0x80,  /* clock divide */
        0xA8, 0x3F,  /* multiplex: 64 rows */
        0xD3, 0x00,  /* display offset 0 */
        0x40,        /* start line 0 */
        0x8D, 0x14,  /* charge pump on */
        0x20, 0x00,  /* horizontal addressing mode */
        0xA1,        /* segment remap (column 127 = SEG0) */
        0xC8,        /* COM scan direction: remapped */
        0xDA, 0x12,  /* COM pins config for 128x64 */
        0x81, 0xCF,  /* contrast */
        0xD9, 0xF1,  /* pre-charge period */
        0xDB, 0x40,  /* VCOMH level */
        0xA4,        /* display follows RAM */
        0xA6,        /* normal (not inverted) */
        0xAF         /* display on */
    };

    for (uint32_t i = 0; i < sizeof(initSeq); i++)
    {
        if (!WriteCmd(initSeq[i])) { return false; }
    }

    SSD1306_Clear();
    return SSD1306_Update();
}

void SSD1306_Clear(void)
{
    memset(frame, 0, sizeof(frame));
}

static void SetPixel(uint32_t x, uint32_t y)
{
    if (x < SSD1306_WIDTH && y < SSD1306_PAGES * 8U)
    {
        frame[x + (y / 8U) * SSD1306_WIDTH] |= (uint8_t)(1U << (y % 8U));
    }
}

static void DrawChar(uint32_t x, uint32_t y, char c, uint32_t scale)
{
    if (c < 32 || c > 126) { c = '?'; }
    const uint8_t *glyph = font5x7[(uint8_t)c - 32U];

    for (uint32_t col = 0; col < 5U; col++)
    {
        for (uint32_t row = 0; row < 7U; row++)
        {
            if (glyph[col] & (1U << row))
            {
                for (uint32_t dx = 0; dx < scale; dx++)
                {
                    for (uint32_t dy = 0; dy < scale; dy++)
                    {
                        SetPixel(x + col * scale + dx, y + row * scale + dy);
                    }
                }
            }
        }
    }
}

void SSD1306_DrawString(uint8_t x, uint8_t y, const char *s, uint8_t scale)
{
    uint32_t cx = x;
    if (scale == 0U) { scale = 1U; }

    while (*s)
    {
        DrawChar(cx, y, *s++, scale);
        cx += 6U * scale;   /* 5 px glyph + 1 px spacing */
    }
}

bool SSD1306_Update(void)
{
    /* Set the full column (0..127) and page (0..7) window, then stream data */
    if (!WriteCmd(0x21) || !WriteCmd(0x00) || !WriteCmd(0x7F)) { return false; }
    if (!WriteCmd(0x22) || !WriteCmd(0x00) || !WriteCmd(0x07)) { return false; }

    for (uint32_t page = 0; page < SSD1306_PAGES; page++)
    {
        /* Control byte 0x40 = the following bytes are display data */
        if (HAL_I2C_Mem_Write(&hi2c1, SSD1306_ADDR, 0x40, I2C_MEMADD_SIZE_8BIT,
                              &frame[page * SSD1306_WIDTH], SSD1306_WIDTH,
                              I2C_TIMEOUT_MS) != HAL_OK)
        {
            return false;
        }
    }
    return true;
}

void SSD1306_SetPower(bool on)
{
    (void)WriteCmd(on ? 0xAF : 0xAE);
}